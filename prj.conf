## CMakeLists.txt
```
cmake_minimum_required(VERSION 3.20.0)
find_package(Zephyr REQUIRED HINTS $ENV{ZEPHYR_BASE})
project(smart_vending_machine)

target_sources(app PRIVATE
    src/main.c
    src/keypad.c
    src/servo_dispense.c
    src/ultrasonic_verify.c
    src/wifi_inventory.c
    src/lcd_i2c.c
)

target_include_directories(app PRIVATE src)
```

## prj.conf
```kconfig
# Zephyr kernel config — Smart Vending Machine (Nucleo-F446RE)

# Threading
CONFIG_MULTITHREADING=y
CONFIG_NUM_PREEMPT_PRIORITIES=16

# Serial / UART
CONFIG_SERIAL=y
CONFIG_UART_INTERRUPT_DRIVEN=y
CONFIG_CONSOLE=y
CONFIG_UART_CONSOLE=y

# SPI (servo PWM via timer, display)
CONFIG_SPI=y
CONFIG_PWM=y

# I2C (LCD)
CONFIG_I2C=y

# GPIO (keypad, ultrasonic, LEDs)
CONFIG_GPIO=y

# Timing
CONFIG_COUNTER=y

# Logging
CONFIG_LOG=y
CONFIG_LOG_DEFAULT_LEVEL=3
```

## src/main.c
```c
/**
 ******************************************************************************
 * @file    main.c
 * @brief   Smart Vending Machine — Zephyr RTOS
 *          Board  : STM32 F446RE (Nucleo-F446RE)
 *          Author : Chlliboina Yaswanth
 ******************************************************************************
 *
 * THREAD ARCHITECTURE
 * ───────────────────
 *  keypad_thread    — scans 4×4 matrix every 50ms, pushes to msgq_keypad
 *  dispense_thread  — waits on msgq_keypad, drives servo via PWM
 *  verify_thread    — fires HC-SR04 after dispense, confirms delivery
 *  wifi_thread      — receives inventory updates, sends via ESP8266
 *  display_thread   — updates I2C LCD on any state change
 *
 ******************************************************************************
 */

#include <zephyr/kernel.h>
#include <zephyr/device.h>
#include <zephyr/drivers/gpio.h>
#include <zephyr/drivers/pwm.h>
#include <zephyr/drivers/i2c.h>
#include <zephyr/drivers/uart.h>
#include <zephyr/logging/log.h>
#include <stdio.h>
#include <string.h>

#include "keypad.h"
#include "servo_dispense.h"
#include "ultrasonic_verify.h"
#include "wifi_inventory.h"
#include "lcd_i2c.h"

LOG_MODULE_REGISTER(vending, LOG_LEVEL_DBG);

/* ── Inventory ──────────────────────────────────── */
typedef struct {
    char     id[4];
    char     name[16];
    uint32_t price;
    uint8_t  stock;
} Product;

static Product inventory[] = {
    {"A1", "Chips",     20, 5},
    {"A2", "Water",     15, 3},
    {"A3", "Soda",      25, 2},
    {"B1", "Biscuits",  10, 4},
    {"B2", "Juice",     30, 1},
};
#define NUM_PRODUCTS 5

/* ── Message Queues ─────────────────────────────── */
K_MSGQ_DEFINE(msgq_keypad,    sizeof(char[4]), 4, 4);  /* Product ID  */
K_MSGQ_DEFINE(msgq_inventory, sizeof(uint8_t), 8, 1);  /* Product idx */

/* ── Semaphores ─────────────────────────────────── */
K_SEM_DEFINE(sem_verify,  0, 1);
K_SEM_DEFINE(sem_display, 0, 1);

/* ── Shared state (protected by mutex) ──────────── */
K_MUTEX_DEFINE(mtx_state);
static char    currentProduct[4]  = "---";
static char    displayLine1[17]   = "Select Product  ";
static char    displayLine2[17]   = "                ";
static uint8_t pendingIdx         = 0xFF;

/* ── Find product by ID ─────────────────────────── */
static int8_t find_product(const char *id)
{
    for (uint8_t i = 0; i < NUM_PRODUCTS; i++)
        if (strncmp(inventory[i].id, id, 2) == 0) return i;
    return -1;
}

/* ── Print inventory ────────────────────────────── */
static void print_inventory(void)
{
    printk("\r\n  Inventory:\r\n");
    for (uint8_t i = 0; i < NUM_PRODUCTS; i++)
        printk("    %s: %-10s Rs.%2d  Stock:%d\r\n",
               inventory[i].id, inventory[i].name,
               inventory[i].price, inventory[i].stock);
    printk("\r\n");
}

/* ────────────────────────────────────────────────
 * THREAD 1 — Keypad Scanner
 * ──────────────────────────────────────────────── */
#define KEYPAD_STACK 512
K_THREAD_STACK_DEFINE(keypad_stack, KEYPAD_STACK);
struct k_thread keypad_tid;

void keypad_thread(void *a, void *b, void *c)
{
    Keypad_Init();
    char sel[4] = {0};
    uint8_t pos = 0;

    while (1)
    {
        char key = Keypad_GetKey();
        if (key != 0)
        {
            if (key == '#' && pos == 2)
            {
                /* Confirm selection */
                sel[2] = '\0';
                LOG_INF("[KEY] Confirmed: %s", sel);
                k_msgq_put(&msgq_keypad, sel, K_NO_WAIT);
                pos = 0;
                memset(sel, 0, sizeof(sel));
            }
            else if (key == '*')
            {
                /* Cancel */
                pos = 0;
                memset(sel, 0, sizeof(sel));
                LOG_INF("[KEY] Cancelled");
            }
            else if (pos < 2)
            {
                sel[pos++] = key;
                LOG_INF("[KEY] Input: %c (pos=%d)", key, pos);
            }
        }
        k_msleep(50);
    }
}

/* ────────────────────────────────────────────────
 * THREAD 2 — Dispense Controller
 * ──────────────────────────────────────────────── */
#define DISPENSE_STACK 512
K_THREAD_STACK_DEFINE(dispense_stack, DISPENSE_STACK);
struct k_thread dispense_tid;

void dispense_thread(void *a, void *b, void *c)
{
    Servo_Init();

    while (1)
    {
        char id[4];
        if (k_msgq_get(&msgq_keypad, id, K_FOREVER) == 0)
        {
            int8_t idx = find_product(id);

            k_mutex_lock(&mtx_state, K_FOREVER);
            strncpy(currentProduct, id, 3);

            if (idx < 0)
            {
                LOG_WRN("[DISP] Unknown product: %s", id);
                snprintf(displayLine1, 17, "Unknown: %s", id);
                snprintf(displayLine2, 17, "Try again       ");
                k_mutex_unlock(&mtx_state);
                k_sem_give(&sem_display);
                continue;
            }

            if (inventory[idx].stock == 0)
            {
                LOG_WRN("[DISP] %s OUT OF STOCK", id);
                snprintf(displayLine1, 17, "%s: OUT STOCK", id);
                snprintf(displayLine2, 17, "                ");
                k_mutex_unlock(&mtx_state);
                k_sem_give(&sem_display);

                /* Notify wifi thread of low stock */
                uint8_t pidx = (uint8_t)idx;
                k_msgq_put(&msgq_inventory, &pidx, K_NO_WAIT);
                continue;
            }

            snprintf(displayLine1, 17, "%s: %s", id, inventory[idx].name);
            snprintf(displayLine2, 17, "Rs.%d Dispensing", inventory[idx].price);
            k_mutex_unlock(&mtx_state);
            k_sem_give(&sem_display);

            LOG_INF("[DISP] Dispensing %s (%s)", id, inventory[idx].name);

            /* Servo: rotate to dispense position */
            Servo_Dispense();
            k_msleep(500);
            Servo_Reset();

            /* Signal verify thread */
            pendingIdx = (uint8_t)idx;
            k_sem_give(&sem_verify);
        }
    }
}

/* ────────────────────────────────────────────────
 * THREAD 3 — Delivery Verifier
 * ──────────────────────────────────────────────── */
#define VERIFY_STACK 512
K_THREAD_STACK_DEFINE(verify_stack, VERIFY_STACK);
struct k_thread verify_tid;

void verify_thread(void *a, void *b, void *c)
{
    Ultrasonic_Init();

    while (1)
    {
        k_sem_take(&sem_verify, K_FOREVER);

        k_msleep(300); /* Wait for item to settle */
        uint32_t dist = Ultrasonic_Measure();
        uint8_t idx   = pendingIdx;

        k_mutex_lock(&mtx_state, K_FOREVER);

        if (dist < 30) /* Item detected at collection tray */
        {
            LOG_INF("[VRFY] DELIVERED — dist=%dcm", dist);
            inventory[idx].stock--;
            snprintf(displayLine1, 17, "Enjoy! Take item");
            snprintf(displayLine2, 17, "%s remaining: %d ",
                     inventory[idx].id, inventory[idx].stock);

            /* Notify wifi to sync inventory */
            k_msgq_put(&msgq_inventory, &idx, K_NO_WAIT);
        }
        else
        {
            LOG_ERR("[VRFY] DELIVERY FAILED — dist=%dcm", dist);
            snprintf(displayLine1, 17, "Error! No item  ");
            snprintf(displayLine2, 17, "Please retry    ");
        }

        k_mutex_unlock(&mtx_state);
        k_sem_give(&sem_display);
    }
}

/* ────────────────────────────────────────────────
 * THREAD 4 — WiFi Inventory Sync
 * ──────────────────────────────────────────────── */
#define WIFI_STACK 768
K_THREAD_STACK_DEFINE(wifi_stack, WIFI_STACK);
struct k_thread wifi_tid;

void wifi_thread(void *a, void *b, void *c)
{
    WiFi_Init();

    while (1)
    {
        uint8_t idx;
        if (k_msgq_get(&msgq_inventory, &idx, K_FOREVER) == 0)
        {
            char msg[64];
            if (inventory[idx].stock == 0)
            {
                snprintf(msg, sizeof(msg),
                         "LOW_STOCK:%s=%d", inventory[idx].id, inventory[idx].stock);
                LOG_WRN("[WIFI] LOW STOCK ALERT: %s=0 >> Sent to server", inventory[idx].id);
            }
            else
            {
                snprintf(msg, sizeof(msg),
                         "UPDATE:%s=%d", inventory[idx].id, inventory[idx].stock);
                LOG_INF("[WIFI] Inventory update sent: %s=%d remaining",
                        inventory[idx].id, inventory[idx].stock);
            }
            WiFi_SendLog(msg);
        }
    }
}

/* ────────────────────────────────────────────────
 * THREAD 5 — LCD Display Updater
 * ──────────────────────────────────────────────── */
#define DISPLAY_STACK 512
K_THREAD_STACK_DEFINE(display_stack, DISPLAY_STACK);
struct k_thread display_tid;

void display_thread(void *a, void *b, void *c)
{
    LCD_Init();
    LCD_Print(0, "Smart Vending   ");
    LCD_Print(1, "STM32 F446RE    ");
    k_msleep(2000);
    LCD_Print(0, "Select Product  ");
    LCD_Print(1, "A1 A2 A3 B1 B2  ");

    while (1)
    {
        k_sem_take(&sem_display, K_FOREVER);
        k_mutex_lock(&mtx_state, K_FOREVER);
        LCD_Print(0, displayLine1);
        LCD_Print(1, displayLine2);
        k_mutex_unlock(&mtx_state);
        k_msleep(3000);
        LCD_Print(0, "Select Product  ");
        LCD_Print(1, "A1 A2 A3 B1 B2  ");
    }
}

/* ────────────────────────────────────────────────
 * MAIN — Spawn all threads
 * ──────────────────────────────────────────────── */
int main(void)
{
    printk("\r\n=========================================\r\n");
    printk("  Smart Vending Machine - Zephyr RTOS\r\n");
    printk("  STM32 F446RE | Yaswanth Chlliboina\r\n");
    printk("=========================================\r\n");
    printk("[RTOS]  Spawning 5 threads...\r\n");

    print_inventory();

    k_thread_create(&keypad_tid,   keypad_stack,   KEYPAD_STACK,
                    keypad_thread,   NULL, NULL, NULL, 5, 0, K_NO_WAIT);
    k_thread_create(&dispense_tid, dispense_stack, DISPENSE_STACK,
                    dispense_thread, NULL, NULL, NULL, 4, 0, K_NO_WAIT);
    k_thread_create(&verify_tid,   verify_stack,   VERIFY_STACK,
                    verify_thread,   NULL, NULL, NULL, 4, 0, K_NO_WAIT);
    k_thread_create(&wifi_tid,     wifi_stack,     WIFI_STACK,
                    wifi_thread,     NULL, NULL, NULL, 6, 0, K_NO_WAIT);
    k_thread_create(&display_tid,  display_stack,  DISPLAY_STACK,
                    display_thread,  NULL, NULL, NULL, 7, 0, K_NO_WAIT);

    printk("[RTOS]  5 threads spawned — System running\r\n");
    printk("[LCD]   \"Select Product\"\r\n\r\n");

    return 0;
}
```

## include/display.h
```c
#ifndef DISPLAY_H
#define DISPLAY_H

int display_init(void);
void display_task(void *p1, void *p2, void *p3);

#endif
```

## include/keypad.h
```c
#ifndef KEYPAD_H
#define KEYPAD_H

int keypad_init(void);
void keypad_task(void *p1, void *p2, void *p3);

#endif
```

## include/servo_dispense.h
```c
#ifndef SERVO_DISPENSE_H
#define SERVO_DISPENSE_H

int servo_dispense_init(void);
void servo_dispense_task(void *p1, void *p2, void *p3);

#endif
```

## include/ultrasonic_verify.h
```c
#ifndef ULTRASONIC_VERIFY_H
#define ULTRASONIC_VERIFY_H

int ultrasonic_verify_init(void);
void ultrasonic_verify_task(void *p1, void *p2, void *p3);

#endif
```

## include/wifi_inventory.h
```c
#ifndef WIFI_INVENTORY_H
#define WIFI_INVENTORY_H

int wifi_inventory_init(void);
void wifi_inventory_task(void *p1, void *p2, void *p3);

#endif
```

## src/display.c
```c
#include <zephyr/kernel.h>
#include <zephyr/logging/log.h>
#include "display.h"

LOG_MODULE_REGISTER(display, CONFIG_LOG_DEFAULT_LEVEL);

int display_init(void)
{
	LOG_INF("Display initialized");
	return 0;
}

void display_task(void *p1, void *p2, void *p3)
{
	ARG_UNUSED(p1);
	ARG_UNUSED(p2);
	ARG_UNUSED(p3);

	while (1) {
		LOG_DBG("Refreshing user display");
		k_sleep(K_MSEC(300));
	}
}
```

## src/keypad.c
```c
/**
 * @file  keypad.c
 * @brief 4×4 Matrix Keypad — Zephyr GPIO driver
 *        Rows: PB3,PB4,PB5,PB6 (Output)
 *        Cols: PC7,PA8,PA9,PA10 (Input Pull-up)
 */
#include "keypad.h"
#include <zephyr/drivers/gpio.h>
#include <zephyr/logging/log.h>

LOG_MODULE_DECLARE(vending);

/* Key map */
static const char keymap[4][4] = {
    {'1','2','3','A'},
    {'4','5','6','B'},
    {'7','8','9','C'},
    {'*','0','#','D'}
};

/* GPIO specs — adjust pin numbers to your board DTS */
static const struct gpio_dt_spec rows[4] = {
    GPIO_DT_SPEC_GET(DT_ALIAS(row0), gpios),
    GPIO_DT_SPEC_GET(DT_ALIAS(row1), gpios),
    GPIO_DT_SPEC_GET(DT_ALIAS(row2), gpios),
    GPIO_DT_SPEC_GET(DT_ALIAS(row3), gpios),
};
static const struct gpio_dt_spec cols[4] = {
    GPIO_DT_SPEC_GET(DT_ALIAS(col0), gpios),
    GPIO_DT_SPEC_GET(DT_ALIAS(col1), gpios),
    GPIO_DT_SPEC_GET(DT_ALIAS(col2), gpios),
    GPIO_DT_SPEC_GET(DT_ALIAS(col3), gpios),
};

void Keypad_Init(void)
{
    for (int i = 0; i < 4; i++) {
        gpio_pin_configure_dt(&rows[i], GPIO_OUTPUT_HIGH);
        gpio_pin_configure_dt(&cols[i], GPIO_INPUT | GPIO_PULL_UP);
    }
}

char Keypad_GetKey(void)
{
    for (int r = 0; r < 4; r++) {
        gpio_pin_set_dt(&rows[r], 0);  /* Pull row LOW */
        for (int c = 0; c < 4; c++) {
            if (gpio_pin_get_dt(&cols[c]) == 0) {
                k_msleep(20);  /* Debounce */
                if (gpio_pin_get_dt(&cols[c]) == 0) {
                    gpio_pin_set_dt(&rows[r], 1);
                    return keymap[r][c];
                }
            }
        }
        gpio_pin_set_dt(&rows[r], 1);  /* Release row */
    }
    return 0;
}
```

## src/keypad.h
```c
#ifndef KEYPAD_H
#define KEYPAD_H
#include <zephyr/kernel.h>
void Keypad_Init(void);
char Keypad_GetKey(void);   /* Returns key char or 0 if none */
#endif
```

## src/lcd_i2c.c
```c
/**
 * @file  lcd_i2c.c
 * @brief 16x2 I2C LCD (PCF8574 backpack) driver — Zephyr I2C1
 *        SDA=PB7, SCL=PB8 on STM32 F446RE
 *        I2C address: 0x27
 */
#include "lcd_i2c.h"
#include <zephyr/drivers/i2c.h>
#include <zephyr/logging/log.h>
#include <string.h>

LOG_MODULE_DECLARE(vending);

#define LCD_ADDR   0x27
#define LCD_COLS   16

static const struct device *i2c1 = DEVICE_DT_GET(DT_ALIAS(lcd_i2c));

static void lcd_send_nibble(uint8_t nibble, uint8_t rs)
{
    uint8_t data = (nibble << 4) | (rs ? 0x01 : 0x00) | 0x08; /* BL=1 */
    uint8_t en_high = data | 0x04;
    uint8_t en_low  = data & ~0x04;
    i2c_write(i2c1, &en_high, 1, LCD_ADDR);
    k_busy_wait(1);
    i2c_write(i2c1, &en_low,  1, LCD_ADDR);
    k_busy_wait(50);
}

static void lcd_send_byte(uint8_t byte, uint8_t rs)
{
    lcd_send_nibble(byte >> 4, rs);
    lcd_send_nibble(byte & 0x0F, rs);
}

void LCD_Init(void)
{
    if (!device_is_ready(i2c1)) { LOG_ERR("LCD I2C not ready"); return; }
    k_msleep(50);
    lcd_send_nibble(0x03, 0); k_msleep(5);
    lcd_send_nibble(0x03, 0); k_busy_wait(150);
    lcd_send_nibble(0x03, 0);
    lcd_send_nibble(0x02, 0);
    lcd_send_byte(0x28, 0);  /* 4-bit, 2 lines */
    lcd_send_byte(0x0C, 0);  /* Display ON, cursor OFF */
    lcd_send_byte(0x06, 0);  /* Entry mode */
    LCD_Clear();
}

void LCD_Clear(void) { lcd_send_byte(0x01, 0); k_msleep(2); }

void LCD_Print(uint8_t row, const char *text)
{
    uint8_t addr = (row == 0) ? 0x80 : 0xC0;
    lcd_send_byte(addr, 0);
    for (uint8_t i = 0; i < LCD_COLS && text[i]; i++)
        lcd_send_byte((uint8_t)text[i], 1);
}
```

## src/lcd_i2c.h
```c
#ifndef LCD_I2C_H
#define LCD_I2C_H
#include <zephyr/kernel.h>
void LCD_Init(void);
void LCD_Print(uint8_t row, const char *text);  /* row: 0 or 1 */
void LCD_Clear(void);
#endif
```

## src/servo_dispense.c
```c
/**
 * @file  servo_dispense.c
 * @brief SG90 Servo PWM driver — Zephyr on STM32 F446RE
 *        Signal pin: PA0 (TIM1 CH1)
 *        50Hz PWM: 1ms pulse=0deg, 1.5ms=90deg
 */
#include "servo_dispense.h"
#include <zephyr/drivers/pwm.h>
#include <zephyr/logging/log.h>

LOG_MODULE_DECLARE(vending);

#define SERVO_PERIOD_NS   20000000U  /* 20ms = 50Hz */
#define SERVO_CLOSE_NS     1000000U  /* 1ms  = 0deg  */
#define SERVO_OPEN_NS      1500000U  /* 1.5ms= 90deg */

static const struct pwm_dt_spec servo = PWM_DT_SPEC_GET(DT_ALIAS(servo0));

void Servo_Init(void)
{
    if (!pwm_is_ready_dt(&servo)) {
        LOG_ERR("Servo PWM not ready");
        return;
    }
    Servo_Reset();
}

void Servo_Dispense(void)
{
    LOG_INF("[DISP]  Servo rotating to 90deg (dispense)...");
    pwm_set_dt(&servo, SERVO_PERIOD_NS, SERVO_OPEN_NS);
    k_msleep(800);
}

void Servo_Reset(void)
{
    LOG_INF("[DISP]  Servo reset to 0deg");
    pwm_set_dt(&servo, SERVO_PERIOD_NS, SERVO_CLOSE_NS);
    k_msleep(500);
}
```

## src/servo_dispense.h
```c
#ifndef SERVO_DISPENSE_H
#define SERVO_DISPENSE_H
#include <zephyr/kernel.h>
void Servo_Init(void);
void Servo_Dispense(void);  /* Rotate to 90deg — drop item */
void Servo_Reset(void);     /* Return to 0deg */
#endif
```
